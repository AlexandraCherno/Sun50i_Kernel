/*
 * Forlinx Technology CO., Ltd. okt507-c soc board.
 *
 * soc board support.
 */
/dts-v1/;

#include "OKT507-C-Common.dtsi"
/{
	soc@03000000 {
		disp: disp@01000000 {
			disp_init_enable         = <1>;
			disp_mode                = <0>;

			screen0_output_type      = <1>;
			screen0_output_mode      = <4>;

			screen1_output_type      = <3>;
			screen1_output_mode      = <5>;

			screen1_output_format    = <0>;
			screen1_output_bits      = <0>;
			screen1_output_eotf      = <4>;
			screen1_output_cs        = <257>;
			screen1_output_dvi_hdmi  = <2>;
			screen1_output_range     = <2>;
			screen1_output_scan      = <0>;
			screen1_output_aspect_ratio = <8>;

			dev0_output_type         = <1>;
			dev0_output_mode         = <4>;
			dev0_screen_id           = <1>;
			dev0_do_hpd              = <0>;

			dev1_output_type         = <4>;
			dev1_output_mode         = <5>;
			dev1_screen_id           = <0>;
			dev1_do_hpd              = <1>;

			def_output_dev           = <0>;
			hdmi_mode_check          = <1>;

			fb0_format               = <0>;
			fb0_width                = <1024>;
			fb0_height               = <600>;

			fb1_format               = <0>;
			fb1_width                = <1280>;
			fb1_height               = <720>;
			chn_cfg_mode             = <1>;

			disp_para_zone           = <1>;
			dc1sw-supply = <&reg_sw>;
			bldo1-supply = <&reg_bldo1>;
			cldo4-supply = <&reg_cldo4>;
		};

		lcd1: lcd1@01c0c001 {
		  	status = "disabled";
		};
	};
};
